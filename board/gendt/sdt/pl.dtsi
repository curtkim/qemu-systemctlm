/ {
	amba_pl: amba_pl {
		ranges;
		compatible = "simple-bus";
		#address-cells = <1>;
		#size-cells = <1>;
		firmware-name = "system.bit.bin";
		clocking0: clocking0 {
			compatible = "xlnx,fclk";
			assigned-clocks = <&clkc 15>;
			assigned-clock-rates = <100000000>;
			#clock-cells = <0>;
			clock-output-names = "fabric_clk";
			clocks = <&clkc 15>;
		};
		accel: accel_axi@40000000 {
			interrupt-parent = <&intc>;
			interrupts = < 0 29 4 >;
			compatible = "xlnx,accel-axi-1.0";
			status = "okay";
			clock-names = "aclk";
			xlnx,ip-name = "accel_axi";
			interrupt-names = "irq";
			xlnx,edk-iptype = "PERIPHERAL";
			reg = <0x40000000 0x1000>;
			clocks = <&clkc 15>;
			xlnx,name = "accel";
		};
	};
};
