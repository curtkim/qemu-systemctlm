/*
 * CAUTION: This file is automatically generated by Xilinx.
 * Version: XSCT 2025.1
 * Today is: Sat Nov  7 12:09:32 2026
 */


/ {
	amba_pl: pl-bus {
		#address-cells = <1>;
		#size-cells = <1>;
		compatible = "simple-bus";
		ranges ;
		accel: accel_axi@40000000 {
			/* This is a place holder node for a custom IP, user may need to update the entries */
			clock-names = "aclk";
			clocks = <&clkc 15>;
			compatible = "xlnx,accel-axi-1.0";
			interrupt-names = "irq";
			interrupt-parent = <&intc>;
			interrupts = <0 29 4>;
			reg = <0x40000000 0x1000>;
		};
	};
};
